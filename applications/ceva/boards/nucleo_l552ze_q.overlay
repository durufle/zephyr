/*
 * Copyright (c) 2023 Laurent Bonnet
 *
 * SPDX-License-Identifier: Apache-2.0
 */

/**
 * trigger 0 = D18, PB13 CN7.5
 * trigger 1 = D27, PB10 CN10.15
 */

/ {
	trigger: trigger {
		compatible = "external-trigger";
		gpios = <&gpiob 13 GPIO_ACTIVE_HIGH>;
	};
	sub_trigger: sub_trigger {
		compatible = "external-trigger";
		gpios = <&gpiob 10 GPIO_ACTIVE_HIGH>;
	};	
};
