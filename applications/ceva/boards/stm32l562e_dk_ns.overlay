/*
 * Copyright (c) 2023 Laurent Bonnet
 *
 * SPDX-License-Identifier: Apache-2.0
 */

/ {
	trigger: trigger {
		compatible = "external-trigger";
		gpios = <&gpiob 13 GPIO_ACTIVE_HIGH>;
	};
	sub_trigger: sub_trigger {
		compatible = "external-trigger";
		gpios = <&gpiob 14 GPIO_ACTIVE_HIGH>;
	};	
};
